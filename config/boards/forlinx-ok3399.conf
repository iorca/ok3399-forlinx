## config/boards/forlinx-ok3399.conf
```kconfig
# Rockchip RK3399 hexa core 4GB eMMC HDMI USB3 PCIe WiFi/BT
BOARD_NAME="Forlinx OK3399"
BOARD_VENDOR="forlinx"
BOARDFAMILY="rockchip64"
BOARD_MAINTAINER="orca"
INTRODUCED="2026"
BOOTCONFIG="ok3399-rk3399_defconfig"
KERNEL_TARGET="current,edge"
KERNEL_TEST_TARGET="current"
FULL_DESKTOP="yes"
BOOT_LOGO="desktop"
BOOT_FDT_FILE="rockchip/rk3399-forlinx-ok3399.dtb"

# rk3399 默认场景：rkbin 的 ddr bin + miniloader + bl31 blob，mainline U-Boot proper。
# 走这条路不需要提供 DRAM sdram-params（我们手上没有 OK3399 的 DDR 参数）。
# 落点由 rockchip64_common.inc::write_uboot_platform() 处理：
#   idbloader.bin -> 扇区 64 / uboot.img -> 扇区 16384 / trust.bin -> 扇区 24576
BOOT_SCENARIO="only-blobs"
BOOT_SUPPORT_SPI=no # OK3399 核心板没有 SPI NOR

BOOTBRANCH_BOARD="tag:v2025.01"
BOOTPATCHDIR="v2025.01"

SRC_CMDLINE="console=ttyS2,1500000 console=tty0"

# ============================================================================
# U-Boot 板级支持：defconfig + board dts + u-boot dtsi
#
# 为什么用 hook 现场写文件，而不是 patch/u-boot/v2025.01/*.patch：
#   armbian 的 patch 注入只认 patch/u-boot/<ver>/ 下的 git patch 文件，
#   defconfig/ dt_upstream_rockchip/ dt_uboot/ 这类子目录在
#   lib/tools/patching.py 里没有任何处理逻辑（RK3588 项目留下的是残留）。
#   用 pre_config_uboot_target__* hook 在源码树里写文件，自包含且可复查。
#   先例：config/boards/rockpro64.conf 就是这么改 rk3399-rockpro64-u-boot.dtsi 的。
# ============================================================================
function pre_config_uboot_target__ok3399_write_uboot_files() {
	display_alert "$BOARD" "writing U-Boot defconfig + board dts + u-boot dtsi" "info"

	# ---- 1. defconfig（基线 nanopc-t4-rk3399：同为 RK808+Syr827/828、无 SPI NOR、
	#         TARGET_EVB_RK3399；只改 DT 名字并加 MMC_HS400） ----
	cat << 'OK3399_DEFCONFIG' > configs/ok3399-rk3399_defconfig
CONFIG_ARM=y
CONFIG_SKIP_LOWLEVEL_INIT=y
CONFIG_COUNTER_FREQUENCY=24000000
CONFIG_ARCH_ROCKCHIP=y
CONFIG_SPL_GPIO=y
CONFIG_NR_DRAM_BANKS=1
CONFIG_ENV_OFFSET=0x3F8000
CONFIG_DEFAULT_DEVICE_TREE="rockchip/rk3399-forlinx-ok3399"
CONFIG_DM_RESET=y
CONFIG_ROCKCHIP_RK3399=y
CONFIG_TARGET_EVB_RK3399=y
CONFIG_SYS_LOAD_ADDR=0x800800
CONFIG_DEBUG_UART_BASE=0xFF1A0000
CONFIG_DEBUG_UART_CLOCK=24000000
CONFIG_PCI=y
CONFIG_DEBUG_UART=y
CONFIG_DEFAULT_FDT_FILE="rockchip/rk3399-forlinx-ok3399.dtb"
CONFIG_DISPLAY_BOARDINFO_LATE=y
CONFIG_SPL_MAX_SIZE=0x40000
CONFIG_SPL_PAD_TO=0x7f8000
# CONFIG_SPL_RAW_IMAGE_SUPPORT is not set
CONFIG_SPL_ATF_NO_PLATFORM_PARAM=y
CONFIG_TPL=y
CONFIG_CMD_BOOTZ=y
CONFIG_CMD_GPT=y
CONFIG_CMD_MMC=y
CONFIG_CMD_PCI=y
CONFIG_CMD_USB=y
# CONFIG_CMD_SETEXPR is not set
CONFIG_CMD_TIME=y
CONFIG_SPL_OF_CONTROL=y
CONFIG_OF_SPL_REMOVE_PROPS="clock-names interrupt-parent assigned-clocks assigned-clock-rates assigned-clock-parents"
CONFIG_ENV_IS_IN_MMC=y
CONFIG_SYS_RELOC_GD_ENV_ADDR=y
CONFIG_ROCKCHIP_GPIO=y
CONFIG_SYS_I2C_ROCKCHIP=y
CONFIG_ROCKCHIP_IODOMAIN=y
CONFIG_MMC_DW=y
CONFIG_MMC_DW_ROCKCHIP=y
CONFIG_MMC_SDHCI=y
CONFIG_MMC_SDHCI_SDMA=y
CONFIG_MMC_SDHCI_ROCKCHIP=y
CONFIG_MMC_HS400_SUPPORT=y
CONFIG_PHY_REALTEK=y
CONFIG_DM_ETH_PHY=y
CONFIG_ETH_DESIGNWARE=y
CONFIG_GMAC_ROCKCHIP=y
CONFIG_NVME_PCI=y
CONFIG_PHY_ROCKCHIP_INNO_USB2=y
CONFIG_PHY_ROCKCHIP_TYPEC=y
CONFIG_PMIC_RK8XX=y
CONFIG_SPL_DM_REGULATOR_FIXED=y
CONFIG_REGULATOR_RK8XX=y
CONFIG_PWM_ROCKCHIP=y
CONFIG_BAUDRATE=1500000
CONFIG_DEBUG_UART_SHIFT=2
CONFIG_SYS_NS16550_MEM32=y
CONFIG_SYSRESET=y
CONFIG_USB=y
CONFIG_USB_XHCI_HCD=y
CONFIG_USB_EHCI_HCD=y
CONFIG_USB_EHCI_GENERIC=y
CONFIG_USB_DWC3=y
CONFIG_USB_DWC3_GENERIC=y
CONFIG_USB_KEYBOARD=y
CONFIG_USB_HOST_ETHER=y
CONFIG_USB_ETHER_ASIX=y
CONFIG_USB_ETHER_ASIX88179=y
CONFIG_USB_ETHER_MCS7830=y
CONFIG_USB_ETHER_RTL8152=y
CONFIG_USB_ETHER_SMSC95XX=y
CONFIG_USB_GADGET=y
CONFIG_ERRNO_STR=y
OK3399_DEFCONFIG

	# ---- 2. U-Boot 专用 board dts ----
	# 必须用单独一份，不能用内核那棵：U-Boot v2025.01 的 dts/upstream 是未拆分的
	# 旧版 rk3399.dtsi（没有 rk3399-base.dtsi、没有 mipi_dsi 标签），
	# 内核 6.18 风格的 dts 给它用编译必挂。
	cat << 'OK3399_UBOOT_DTS' > dts/upstream/src/arm64/rockchip/rk3399-forlinx-ok3399.dts
// SPDX-License-Identifier: (GPL-2.0+ OR MIT)
/*
 * U-Boot build device tree for Forlinx OK3399 (RK3399).
 *
 * This tree is ONLY for U-Boot. The kernel uses the rk3399-forlinx-ok3399.dts
 * shipped via patch/kernel/rockchip64-current/dt (mainline 6.18 style), which
 * is incompatible with U-Boot v2025.01's dts/upstream copy of rk3399.dtsi --
 * that one is the pre-split version with no 'mipi_dsi' label.
 *
 * PMIC facts taken from Forlinx vendor ok3399.dts (authoritative):
 *   - RK808 @0x1b, all vcc1..vcc12-supply = vcc3v3_sys
 *   - vddio-supply = vcc_3v0 (LDO_REG8)
 *   - vdd_center  = DCDC_REG1 (NOT a pwm-regulator)
 *   - LDO_REG4 = vccio_sd
 */

/dts-v1/;
#include <dt-bindings/gpio/gpio.h>
#include <dt-bindings/interrupt-controller/irq.h>
#include <dt-bindings/pinctrl/rockchip.h>
#include "rk3399.dtsi"

/ {
	model = "Forlinx OK3399";
	compatible = "forlinx,ok3399", "rockchip,rk3399";

	aliases {
		mmc0 = &sdhci;
		mmc1 = &sdmmc;
		serial2 = &uart2;
	};

	chosen {
		stdout-path = "serial2:1500000n8";
	};

	vcc3v3_sys: vcc3v3-sys {
		compatible = "regulator-fixed";
		regulator-name = "vcc3v3_sys";
		regulator-always-on;
		regulator-boot-on;
		regulator-min-microvolt = <3300000>;
		regulator-max-microvolt = <3300000>;
	};

	vcc5v0_sys: vcc5v0-sys {
		compatible = "regulator-fixed";
		regulator-name = "vcc5v0_sys";
		regulator-always-on;
		regulator-boot-on;
		regulator-min-microvolt = <5000000>;
		regulator-max-microvolt = <5000000>;
	};
};

&i2c0 {
	status = "okay";
	i2c-scl-rising-time-ns = <168>;
	i2c-scl-falling-time-ns = <4>;
	clock-frequency = <400000>;

	rk808: pmic@1b {
		compatible = "rockchip,rk808";
		reg = <0x1b>;
		interrupt-parent = <&gpio1>;
		interrupts = <21 IRQ_TYPE_LEVEL_LOW>;
		pinctrl-names = "default";
		pinctrl-0 = <&pmic_int_l>;
		rockchip,system-power-controller;
		wakeup-source;
		#clock-cells = <1>;
		clock-output-names = "xin32k", "rk808-clkout2";

		vcc1-supply = <&vcc3v3_sys>;
		vcc2-supply = <&vcc3v3_sys>;
		vcc3-supply = <&vcc3v3_sys>;
		vcc4-supply = <&vcc3v3_sys>;
		vcc6-supply = <&vcc3v3_sys>;
		vcc7-supply = <&vcc3v3_sys>;
		vcc8-supply = <&vcc3v3_sys>;
		vcc9-supply = <&vcc3v3_sys>;
		vcc10-supply = <&vcc3v3_sys>;
		vcc11-supply = <&vcc3v3_sys>;
		vcc12-supply = <&vcc3v3_sys>;
		vddio-supply = <&vcc_3v0>;

		regulators {
			vdd_center: DCDC_REG1 {
				regulator-name = "vdd_center";
				regulator-always-on;
				regulator-boot-on;
				regulator-min-microvolt = <750000>;
				regulator-max-microvolt = <1350000>;
				regulator-ramp-delay = <6001>;
				regulator-state-mem {
					regulator-off-in-suspend;
				};
			};

			vdd_cpu_l: DCDC_REG2 {
				regulator-name = "vdd_cpu_l";
				regulator-always-on;
				regulator-boot-on;
				regulator-min-microvolt = <750000>;
				regulator-max-microvolt = <1350000>;
				regulator-ramp-delay = <6001>;
				regulator-state-mem {
					regulator-off-in-suspend;
				};
			};

			vcc_ddr: DCDC_REG3 {
				regulator-name = "vcc_ddr";
				regulator-always-on;
				regulator-boot-on;
				regulator-state-mem {
					regulator-on-in-suspend;
				};
			};

			vcc_1v8: DCDC_REG4 {
				regulator-name = "vcc_1v8";
				regulator-always-on;
				regulator-boot-on;
				regulator-min-microvolt = <1800000>;
				regulator-max-microvolt = <1800000>;
				regulator-state-mem {
					regulator-on-in-suspend;
					regulator-suspend-microvolt = <1800000>;
				};
			};

			vcc1v8_pmu: LDO_REG3 {
				regulator-name = "vcc1v8_pmu";
				regulator-always-on;
				regulator-boot-on;
				regulator-min-microvolt = <1800000>;
				regulator-max-microvolt = <1800000>;
				regulator-state-mem {
					regulator-on-in-suspend;
					regulator-suspend-microvolt = <1800000>;
				};
			};

			vccio_sd: LDO_REG4 {
				regulator-name = "vccio_sd";
				regulator-always-on;
				regulator-boot-on;
				regulator-min-microvolt = <1800000>;
				regulator-max-microvolt = <3000000>;
				regulator-state-mem {
					regulator-on-in-suspend;
					regulator-suspend-microvolt = <3000000>;
				};
			};

			vcc_3v0: LDO_REG8 {
				regulator-name = "vcc_3v0";
				regulator-always-on;
				regulator-boot-on;
				regulator-min-microvolt = <3000000>;
				regulator-max-microvolt = <3000000>;
				regulator-state-mem {
					regulator-on-in-suspend;
					regulator-suspend-microvolt = <3000000>;
				};
			};
		};
	};
};

&sdhci {
	bus-width = <8>;
	mmc-hs400-1_8v;
	mmc-hs400-enhanced-strobe;
	non-removable;
	status = "okay";
};

&sdmmc {
	bus-width = <4>;
	cap-mmc-highspeed;
	cap-sd-highspeed;
	disable-wp;
	max-frequency = <150000000>;
	pinctrl-names = "default";
	pinctrl-0 = <&sdmmc_clk &sdmmc_cmd &sdmmc_cd &sdmmc_bus4>;
	vmmc-supply = <&vccio_sd>;
	status = "okay";
};

&uart2 {
	status = "okay";
};

&pinctrl {
	pmic {
		pmic_int_l: pmic-int-l {
			rockchip,pins = <1 RK_PC5 RK_FUNC_GPIO &pcfg_pull_up>;
		};
	};
};
OK3399_UBOOT_DTS

	# ---- 3. u-boot dtsi：只引用 SoC 级 label ----
	# 严禁 include rk3399-nanopi4-u-boot.dtsi：它引用 &vcc3v0_sd / &sdmmc0_pwr_h /
	# &vcc_sdio 这些 nanopi4 专有 label，用在别的板上 dtc 必挂。
	cat << 'OK3399_UBOOT_DTSI' > arch/arm/dts/rk3399-forlinx-ok3399-u-boot.dtsi
// SPDX-License-Identifier: GPL-2.0+
/*
 * U-Boot specific bits for Forlinx OK3399.
 * Only references SoC-level labels from rk3399.dtsi / rk3399-u-boot.dtsi.
 */

#include "rk3399-u-boot.dtsi"

/ {
	chosen {
		stdout-path = "serial2:1500000n8";
	};
};

&sdmmc {
	bus-width = <4>;
	cap-sd-highspeed;
	disable-wp;
	max-frequency = <150000000>;
	pinctrl-names = "default";
	pinctrl-0 = <&sdmmc_clk &sdmmc_cmd &sdmmc_cd &sdmmc_bus4>;
	status = "okay";
};

&vdd_center {
	regulator-init-microvolt = <900000>;
};
OK3399_UBOOT_DTSI
}

# ============================================================================
# only-blobs 需要 trust.ini：rockchip64_common.inc:305 调用 trust_merger，
# 但 armbian/rkbin 是裁剪版 fork（没有 RKTRUST/RK3399TRUST.ini），缺件会
# "config(trust.ini) not found! merge failed!"。
# 这里按 rockchip-linux/rkbin 的官方 RK3399TRUST.ini 现场生成（BL31 ADDR=0x00040000，不打包 TEE）。
# ============================================================================
function pre_config_uboot_target__ok3399_write_trust_ini() {
	display_alert "$BOARD" "writing trust.ini for trust_merger (rkbin fork has no RKTRUST/)" "info"
	cat << 'OK3399_TRUST_INI' > trust.ini
[VERSION]
MAJOR=1
MINOR=0
[BL30_OPTION]
SEC=0
[BL31_OPTION]
SEC=1
PATH=bl31.elf
ADDR=0x00040000
[BL32_OPTION]
SEC=0
[BL33_OPTION]
SEC=0
[OUTPUT]
PATH=trust.bin
OK3399_TRUST_INI
}

# BOOT_SOC 由 BOOTCONFIG 提取（rockchip64_common.inc:214），必须含 "rk3399_"
function post_family_config__ok3399_kernel_patchdir() {
	# patch/kernel 下没有 rockchip64 目录 -> current 分支 KERNELPATCHDIR 为空，
	# 自研板 dts 不会被编进镜像且不报错。必须显式声明。
	declare -g KERNELPATCHDIR="rockchip64-current"
	display_alert "$BOARD" "KERNELPATCHDIR=${KERNELPATCHDIR} (dts injected)" "info"
}
```
